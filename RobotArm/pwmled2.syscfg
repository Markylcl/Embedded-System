// These arguments were used when this file was generated. They will be automatically applied on subsequent loads 
// via the GUI or CLI invocations. Run CLI with '--help' for additional information on how to override these arguments.
// @cliArgs --board "/ti/boards/CC3220SF_LAUNCHXL" --product "SimpleLinkSDK@3.20.00.06"
// @versions {"data":"2019083011","timestamp":"2019083011","tool":"1.2.952","templates":"2019083011"}

var RTOS = scripting.addModule("/ti/drivers/RTOS");
var PWM = scripting.addModule("/ti/drivers/PWM");
var PWM1 = PWM.addInstance();
var Power = scripting.addModule("/ti/drivers/Power");
var Board = scripting.addModule("/ti/drivers/Board");
var PWM2 = PWM.addInstance();
var PWM3 = PWM.addInstance();
var PWM4 = PWM.addInstance();
var UART = scripting.addModule("/ti/drivers/UART");
var UART1 = UART.addInstance();
var SimpleLinkWifi = scripting.addModule("/ti/drivers/net/wifi/SimpleLinkWifi");
var SPI = scripting.addModule("/ti/drivers/SPI");
var DMA = scripting.addModule("/ti/drivers/DMA");
var SPI1 = SPI.addInstance();
var Crypto = scripting.addModule("/ti/drivers/Crypto");
var Crypto1 = Crypto.addInstance();
// Name - The C/C++ identifier used in applications as the index parameter passed to PWM runtime APIs
PWM1.$name = "Board_PWM0";
// Use Hardware - Select the hardware to use, or 'None' to use available header pins
PWM1.$hardware = system.deviceData.board.components.LED_YELLOW;
// Name
PWM1.timer.$name = "MyTimer1";
// Name
Power.parkPins.$name = "ti_drivers_power_PowerCC32XXPins0";
// Name - The C/C++ identifier used in applications as the index parameter passed to PWM runtime APIs
PWM2.$name = "Board_PWM1";
// Use Hardware - Select the hardware to use, or 'None' to use available header pins
PWM2.$hardware = system.deviceData.board.components.LED_GREEN;
// Name
PWM2.timer.$name = "MyTimer1";
// Name - The C/C++ identifier used in applications as the index parameter passed to PWM runtime APIs
PWM3.$name = "Board_PWM2";
// Use Hardware - Select the hardware to use, or 'None' to use available header pins
PWM3.$hardware = system.deviceData.board.components.LED_RED;
// Name
PWM3.timer.$name = "MyTimer1";
// Name - The C/C++ identifier used in applications as the index parameter passed to PWM runtime APIs
PWM4.$name = "Board_PWM3";
// Name
PWM4.timer.$name = "MyTimer1";
// Name - The C/C++ identifier used in applications as the index parameter passed to UART runtime APIs
UART1.$name = "Board_UART0";
// Use Hardware - Select the hardware to use, or 'None' to use available header pins
UART1.$hardware = system.deviceData.board.components.xds110Uart;
// Name
UART1.uart.$name = "MyUART1";
// Use Peripheral
UART1.uart.$assign = "UART0";
// Assign pin
UART1.uart.txPin.$assign = "GP01"; // pin number - 55
// Assign pin
UART1.uart.rxPin.$assign = "GP02"; // pin number - 57
// Name - The C/C++ identifier used in applications as the index parameter passed to SPI runtime APIs
SPI1.$name = "Board_SPI0";
// Name
SPI1.spi.$name = "MySPI1";
// Name - The C/C++ identifier used in applications as the index parameter passed to Crypto runtime APIs
Crypto1.$name = "Board_Crypto0";
// Suggest solution
PWM1.timer.$suggestSolution = "Timer3";
// Suggest solution
PWM1.timer.pwmPin.$suggestSolution = "1";
// Suggest solution
PWM2.timer.$suggestSolution = "Timer3";
// Suggest solution
PWM2.timer.pwmPin.$suggestSolution = "2";
// Suggest solution
PWM3.timer.$suggestSolution = "Timer2";
// Suggest solution
PWM3.timer.pwmPin.$suggestSolution = "64";
// Suggest solution
PWM4.timer.$suggestSolution = "Timer1";
// Suggest solution
PWM4.timer.pwmPin.$suggestSolution = "21";
// Suggest solution
SPI1.spi.$suggestSolution = "SPI0";
// Suggest solution
SPI1.spi.sclkPin.$suggestSolution = "5";
// Suggest solution
SPI1.spi.misoPin.$suggestSolution = "6";
// Suggest solution
SPI1.spi.mosiPin.$suggestSolution = "7";
// Suggest solution
SPI1.spi.dmaRxChannel.$suggestSolution = "UDMA_CH30";
// Suggest solution
SPI1.spi.dmaTxChannel.$suggestSolution = "UDMA_CH31";
